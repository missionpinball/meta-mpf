## conf/distro/mpf.conf
```bitbake
require conf/distro/poky.conf
DISTRO = "mpf"

# DISTRO_FEATURES="acl alsa argp bluetooth ext2 ipv4 ipv6 largefile pcmcia usbgadget usbhost wifi xattr nfs zeroconf pci 3g nfc x11 vfat largefile opengl ptest multiarch wayland vulkan pulseaudio sysvinit gobject-introspection-data ldconfig"
# REMOVED: bluetooth pcmcia wifi nfs zeroconf 3g nfc wayland
DISTRO_FEATURES="acl alsa argp ext2 ipv4 ipv6 largefile usbgadget usbhost xattr pci vfat largefile opengl ptest multiarch vulkan pulseaudio sysvinit gobject-introspection-data ldconfig x11"
```

## conf/layer.conf
```bitbake
# We have a conf and classes directory, add to BBPATH
BBPATH .= ":${LAYERDIR}"

# We have recipes-* directories, add to BBFILES
BBFILES += "${LAYERDIR}/recipes-*/*/*.bb \
            ${LAYERDIR}/recipes-*/*/*.bbappend"

BBFILE_COLLECTIONS += "meta-mpf"
BBFILE_PATTERN_meta-mpf = "^${LAYERDIR}/"
BBFILE_PRIORITY_meta-mpf = "6"

LAYERDEPENDS_meta-mpf = "core"
LAYERSERIES_COMPAT_meta-mpf = "dunfell"
```
